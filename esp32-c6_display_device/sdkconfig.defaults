## esp32-c6_display_device/sdkconfig.defaults
```kconfig
#
# Partition Table
#
CONFIG_PARTITION_TABLE_CUSTOM=y
CONFIG_PARTITION_TABLE_CUSTOM_FILENAME="partitions.csv"
CONFIG_PARTITION_TABLE_FILENAME="partitions.csv"
CONFIG_PARTITION_TABLE_OFFSET=0x8000
CONFIG_PARTITION_TABLE_MD5=y
# end of Partition Table

#
# Flash
#
CONFIG_ESPTOOLPY_FLASHSIZE_4MB=y
CONFIG_ESPTOOLPY_FLASHSIZE="4MB"

#
# CPU: cap at 80 MHz to reduce heat (mains test node, no heavy compute)
#
CONFIG_ESP_DEFAULT_CPU_FREQ_MHZ_80=y
CONFIG_ESP_DEFAULT_CPU_FREQ_MHZ=80

#
# Zigbee
#
CONFIG_ZB_ENABLED=y
CONFIG_ZB_ZCZR=y
# CONFIG_ZB_ZED is not set
CONFIG_ZB_RADIO_NATIVE=y

#
# LVGL
#
CONFIG_LV_FONT_MONTSERRAT_14=y
CONFIG_LV_FONT_MONTSERRAT_16=y
CONFIG_LV_FONT_MONTSERRAT_20=y
CONFIG_LV_FONT_MONTSERRAT_28=y
```

## esp32-p4_HA_v2/claw_ha/Kconfig
```kconfig
menu "HA Claw (local agent)"

config HA_CLAW_ENABLE
    bool "Enable ESP-Claw framework (local agent over Domain)"
    default y
    help
        Подключить framework-компоненты ESP-Claw (claw_core/claw_cap) как локального
        потребителя Domain. Shell esp-claw (app_claw/app_config/board/FATFS) не тянем.

config HA_CLAW_SELFTEST
    bool "Claw self-test: submit one request at boot"
    depends on HA_CLAW_ENABLE
    default y
    help
        На старте отправить одну тестовую заявку (mock LLM -> tool_call home_ping) и
        залогировать ответ. Временный bring-up шаг (C2.1), позже выключить.

config HA_CLAW_USE_REAL_LLM
    bool "Use a real LLM (OpenAI-compatible) instead of the mock backend"
    depends on HA_CLAW_ENABLE
    default n
    help
        Включить реальный HTTPS-бэкенд (OpenAI-совместимый, напр. Gemini/DeepSeek).
        Требует сеть, синхронизированное время и API key ниже.

config HA_CLAW_LLM_BACKEND
    string "LLM backend id"
    depends on HA_CLAW_USE_REAL_LLM
    default "openai_compatible"

config HA_CLAW_LLM_BASE_URL
    string "LLM base URL (OpenAI-compatible)"
    depends on HA_CLAW_USE_REAL_LLM
    default ""

config HA_CLAW_LLM_MODEL
    string "LLM model"
    depends on HA_CLAW_USE_REAL_LLM
    default ""

config HA_CLAW_LLM_API_KEY
    string "LLM API key (stored in local sdkconfig only; never commit)"
    depends on HA_CLAW_USE_REAL_LLM
    default ""

endmenu
```

## esp32-p4_HA_v2/main/Kconfig.projbuild
```kconfig
menu "HA debug"

config HA_DEBUG_HEAP_PROBE
    bool "Periodic heap probe (internal free/min-ever/largest, PSRAM)"
    default y
    help
        Периодический лог памяти для наблюдения за Claw/TLS на реальном устройстве.
        Выключается после стабилизации.

endmenu
```

## esp32-p4_HA_v2/mstore/Kconfig
```kconfig
menu "mstore"

    config MSTORE_FLASH_PARTITION_LABEL
        string "Partition label for mstore FLASH backing"
        default "mstore"
        help
            Data partition, используемая как NOR-регион для FLASH / RAM+FLASH
            backing. Партиция ищется по этой метке при первом обращении.

    config MSTORE_FLASH_APPEND_HEADROOM_PERCENT
        int "FLASH append headroom, percent of capacity"
        range 0 200
        default 25
        help
            Сколько записей сверх capacity помещается в банку после compaction.
            Одна запись (прежняя политика) давала checkpoint почти на каждый
            update при заполненной таблице: worst-case latency до 4.2 с на
            capacity 5000 (замеры — docs/storage/MSTORE_BENCH.md). Запас
            резервирует FLASH-регион, а не RAM.

    config MSTORE_FLASH_APPEND_HEADROOM_MIN
        int "FLASH append headroom, minimum records"
        range 1 1024
        default 8
        help
            Нижняя граница запаса: маленькие таблицы не должны компактиться
            на каждой мутации.

endmenu
```

## esp32-p4_HA_v2/mstore/test_apps/mstore_bench/main/Kconfig.projbuild
```kconfig
menu "mstore bench"

    choice BENCH_MODE
        prompt "Storage mode to measure"
        default BENCH_MODE_ALL
        help
            Режимы прогоняются отдельно: у каждого свой persist_key и свой FLASH-регион.

        config BENCH_MODE_ALL
            bool "all: RAM, FLASH, RAM|FLASH"
        config BENCH_MODE_RAM
            bool "RAM only"
        config BENCH_MODE_FLASH
            bool "FLASH only"
        config BENCH_MODE_RAM_FLASH
            bool "RAM|FLASH only"
    endchoice

    config BENCH_FIND_READ_OPS
        int "find/read operations per capacity"
        default 5000
        help
            Количество find и отдельно read на каждой capacity в сценарии fill/read.

    config BENCH_STRESS_OPS
        int "mixed write-stress operations"
        default 5000

    config BENCH_CHECKPOINT_CAPACITY
        int "capacity for worst-case checkpoint scenario"
        default 200

    config BENCH_CHECKPOINT_UPDATES
        int "updates in worst-case checkpoint scenario"
        default 5000

    config BENCH_SOAK_SECONDS
        int "long soak duration, seconds (0 = skip)"
        default 0

    config BENCH_LOADED_MODE
        bool "run write stress also with a background CPU load task"
        default y

endmenu
```

## esp32-p4_HA_v2/web/Kconfig.projbuild
```kconfig
menu "Web service"

    config WEB_MDNS_HOSTNAME
        string "mDNS hostname"
        default "esp32p4"

endmenu
```

## esp32-p4_HA_v2/wifi/Kconfig.projbuild
```kconfig
menu "Wi-Fi service"

    config WIFI_SSID
        string "Wi-Fi SSID (bring-up seed)"
        default ""
        help
            Точка доступа для автоподключения, если список известных сетей пуст.
            Значение задаётся в sdkconfig (не в git); в будущем — через provisioning
            (Display/Web). Владелец радио — сервис wifi, поэтому креды живут здесь.

    config WIFI_PASSWORD
        string "Wi-Fi password"
        default ""

endmenu
```
