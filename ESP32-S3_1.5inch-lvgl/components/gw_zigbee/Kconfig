## ESP32-S3_1.5inch-lvgl/components/gw_zigbee/Kconfig
```kconfig
menu "GW Zigbee UART Backend"

config GW_ZIGBEE_UART_PORT
    int "UART port for C6 link"
    range 0 2
    default 1

config GW_ZIGBEE_UART_TX_PIN
    int "UART TX pin (S3 -> C6 RX)"
    default 39

config GW_ZIGBEE_UART_RX_PIN
    int "UART RX pin (S3 <- C6 TX)"
    default 40

config GW_ZIGBEE_UART_BAUD
    int "UART baudrate"
    range 9600 2000000
    default 115200

config GW_ZIGBEE_UART_RSP_TIMEOUT_MS
    int "Command response timeout (ms)"
    range 100 10000
    default 1200

config GW_ZIGBEE_UART_TRACE
    bool "Enable UART TX/RX trace logs"
    default n

endmenu
```

## ESP32-S3_1.5inch-lvgl/sdkconfig.defaults
```kconfig
CONFIG_HTTPD_WS_SUPPORT=y
# Keep WS streaming off by default on S3 backend; enable from menuconfig when needed
# CONFIG_GW_HTTP_WS_ENABLE is not set

CONFIG_SPIRAM_MALLOC_ALWAYSINTERNAL=8192
CONFIG_SPIRAM_TRY_ALLOCATE_WIFI_LWIP=y
CONFIG_NVS_ALLOCATE_CACHE_IN_SPIRAM=y
CONFIG_MBEDTLS_EXTERNAL_MEM_ALLOC=y
CONFIG_SPIRAM_MALLOC_RESERVE_INTERNAL=65536
CONFIG_ESP_WIFI_STATIC_TX_BUFFER_NUM=8
CONFIG_ESP_WIFI_STATIC_RX_BUFFER_NUM=8
CONFIG_ESP_WIFI_DYNAMIC_RX_BUFFER_NUM=16
CONFIG_ESP_WIFI_MGMT_SBUF_NUM=16
CONFIG_ESP_WIFI_CACHE_TX_BUFFER_NUM=16
CONFIG_GW_ZIGBEE_UART_BAUD=230400
CONFIG_GW_ZIGBEE_UART_TX_PIN=39
CONFIG_GW_ZIGBEE_UART_RX_PIN=40
CONFIG_GW_ZIGBEE_UART_TRACE=y
CONFIG_ESP_SYSTEM_EVENT_TASK_STACK_SIZE=4096
```
